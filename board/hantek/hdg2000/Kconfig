## board/hantek/hdg2000/Kconfig
```kconfig
if TARGET_HANTEK_HDG2000

config SYS_BOARD
	default "hdg2000"

config SYS_VENDOR
	default "hantek"

config SYS_SOC
	default "s3c24x0"

config SYS_CONFIG_NAME
	default "hdg2000"

endif
```

## configs/hantek_hdg2000_defconfig
```kconfig
CONFIG_ARM=y
CONFIG_SPL=y
CONFIG_SPL_NAND_DENALI=y
CONFIG_TARGET_HANTEK_HDG2000=y
```
